/* Copyright (c) 2017-2018, The Linux Foundation. All rights reserved.
 *
 * This program is free software; you can redistribute it and/or modify
 * it under the terms of the GNU General Public License version 2 and
 * only version 2 as published by the Free Software Foundation.
 *
 * This program is distributed in the hope that it will be useful,
 * but WITHOUT ANY WARRANTY; without even the implied warranty of
 * MERCHANTABILITY or FITNESS FOR A PARTICULAR PURPOSE.  See the
 * GNU General Public License for more details.
 */

&mdss_mdp {
	dsi_tianma_rm69091_300p_cmd: qcom,mdss_dsi_tianma_rm69091_300p_cmd {
		qcom,mdss-dsi-panel-name = "Tianma RM69091 300p command mode dsi panel";
		qcom,mdss-dsi-panel-type = "dsi_cmd_mode";
		qcom,mdss-dsi-panel-framerate = <60>;
		qcom,mdss-dsi-virtual-channel-id = <0>;
		qcom,mdss-dsi-stream = <0>;
		qcom,mdss-dsi-panel-width = <300>;
		qcom,mdss-dsi-panel-height = <300>;
		qcom,mdss-pan-physical-height-dimension = <25>;
		qcom,mdss-pan-physical-width-dimension = <25>;
		qcom,mdss-dsi-h-front-porch = <40>;
		qcom,mdss-dsi-h-back-porch = <20>;
		qcom,mdss-dsi-h-pulse-width = <2>;
		qcom,mdss-dsi-h-sync-skew = <0>;
		qcom,mdss-dsi-v-back-porch = <18>;
		qcom,mdss-dsi-v-front-porch = <18>;
		qcom,mdss-dsi-v-pulse-width = <2>;
		qcom,mdss-dsi-h-left-border = <0>;
		qcom,mdss-dsi-h-right-border = <0>;
		qcom,mdss-dsi-v-top-border = <0>;
		qcom,mdss-dsi-v-bottom-border = <0>;
		qcom,mdss-dsi-bpp = <24>;
		qcom,mdss-dsi-color-order = "rgb_swap_rgb";
		qcom,mdss-dsi-underflow-color = <0xff>;
		qcom,mdss-dsi-border-color = <0>;
		qcom,mdss-tear-check-frame-rate = <4500>;
		qcom,mdss-dsi-idle-fps = <10>;
		qcom,mdss-dsi-on-command = [
			39 01 00 00 00 00 02 FE 05
			39 01 00 00 00 00 02 2A 02
			39 01 00 00 00 00 02 30 00
			39 01 00 00 00 00 02 05 00
			39 01 00 00 00 00 02 FE 00
			39 01 00 00 00 00 02 35 01
			39 01 00 00 00 00 02 51 00
			39 01 00 00 00 00 02 53 20
			39 01 00 00 00 00 05 2A 00 0A 01 35
			39 01 00 00 00 00 05 2B 00 00 01 2B
			05 01 00 00 7E 00 02 11 00
			05 01 00 00 05 00 02 29 00
			];
		qcom,mdss-dsi-off-command = [
			05 01 00 00 32 00 02 28 00
			05 01 00 00 32 00 02 10 00
			39 01 00 00 82 00 02 4F 01
			];
		qcom,mdss-dsi-on-command-state = "dsi_lp_mode";
		qcom,mdss-dsi-off-command-state = "dsi_hs_mode";

		qcom,mdss-dsi-idle-on-command = [
			39 01 00 00 00 00 02 FE 00
			05 01 00 00 00 00 01 39 /* Idle-Mode On */
			];
		qcom,mdss-dsi-idle-on-command-state = "dsi_hs_mode";
		qcom,mdss-dsi-idle-off-command = [
			39 01 00 00 00 00 02 FE 00
			05 01 00 00 00 00 01 38 /* Idle-Mode Off  */
			/* Reset column start address*/
			39 01 00 00 00 00 05 2A 00 0A 01 35
			/* Reset row start address */
			39 01 00 00 00 00 05 2B 00 00 01 2B
			];
		qcom,mdss-dsi-traffic-mode = "burst_mode";
		qcom,mdss-dsi-lane-map = "lane_map_0123";
		qcom,mdss-dsi-bllp-eof-power-mode;
		qcom,mdss-dsi-bllp-power-mode;
		qcom,mdss-dsi-lane-0-state;
		qcom,mdss-dsi-te-pin-select = <1>;
		qcom,mdss-dsi-te-dcs-command = <1>;
		qcom,mdss-dsi-te-using-te-pin;
		qcom,mdss-dsi-te-check-enable;
		qcom,mdss-dsi-panel-timings = [41 10 06 00 28 28 0E
			12 09 03 04 00];
		qcom,mdss-dsi-t-clk-post = <0x05>;
		qcom,mdss-dsi-t-clk-pre = <0x11>;
		qcom,mdss-dsi-bl-min-level = <20>;
		qcom,mdss-dsi-bl-max-level = <255>;
		qcom,mdss-dsi-dma-trigger = "trigger_sw";
		qcom,mdss-dsi-mdp-trigger = "none";
		qcom,mdss-dsi-bl-pmic-control-type = "bl_ctrl_dcs";
		qcom,mdss-dsi-reset-sequence = <1 02>, <0 10>, <1 20>;
		/*qcom,esd-check-enabled;*/
		/*qcom,mdss-dsi-panel-status-check-mode = "te_signal_check";*/
		qcom,mdss-dsi-init-delay-us = <2000>;
	};
};
