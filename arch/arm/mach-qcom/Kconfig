## arch/arm/mach-qcom/Kconfig
```kconfig
menuconfig ARCH_QCOM
	bool "Qualcomm Support" if ARCH_MULTI_V7
	select ARCH_REQUIRE_GPIOLIB
	select ARM_GIC
	select ARM_AMBA
	select CLKSRC_OF
	select PINCTRL
	select QCOM_SCM if SMP
	help
	  Support for Qualcomm's devicetree based systems.

if ARCH_QCOM

config ARCH_MSM8X60
	bool "Enable support for MSM8X60"
	select CLKSRC_QCOM

config ARCH_MSM8960
	bool "Enable support for MSM8960"
	select CLKSRC_QCOM

config ARCH_MSM8974
	bool "Enable support for MSM8974"
	select HAVE_ARM_ARCH_TIMER

config QCOM_SCM
	bool

endif



config ZTE_PIL_AUTH_ERROR_DETECTION
	bool "ZTE PIL AUTH ERROR DETECTION"
	default n
	help
	  When authorization of PIL images is failed, the system
	  will enter into UNAUTH mode to show related error message.
```

## drivers/input/touchscreen/vendor/Kconfig
```kconfig
#
# Touchscreen driver configuration
#
config TOUCHSCREEN_VENDOR
	bool "Vendor Touch Panel Driver"
	help
	  Say Y here if you have Vendor touch panel.

	  If unsure, say N.

	  To compile this dirver as a module, choose M here: the
	  module will be called.

if TOUCHSCREEN_VENDOR

source "drivers/input/touchscreen/vendor/cypress/Kconfig"

config TS_FIRMWARE
	string "config board firmware folder"

endif
```

## drivers/soc/qcom/vendor/Kconfig
```kconfig
source "drivers/soc/qcom/vendor/vlog/Kconfig"
source "drivers/soc/qcom/vendor/logcat/Kconfig"
source "drivers/soc/qcom/vendor/sdlog/Kconfig"
source "drivers/soc/qcom/vendor/pmlog/Kconfig"
source "drivers/soc/qcom/vendor/klog/Kconfig"
source "drivers/soc/qcom/vendor/imem_info/Kconfig"
source "drivers/soc/qcom/vendor/vcfg/Kconfig"
```

## drivers/soc/qcom/vendor/klog/Kconfig
```kconfig
#
# printk_ext driver
#
config PRINTK_EXT
    bool "/proc/kmsg_ext support"
    default n
    help
      Say Y here if you want to support the /proc/kmsg_ext. In
      this case, carve out a block of memory to store a specific
      log, rather than store it in the printk's buffer.
```
